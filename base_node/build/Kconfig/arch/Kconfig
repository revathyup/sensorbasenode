## base_node/build/Kconfig/arch/Kconfig
```kconfig
# Load Zephyr Arch Kconfig descriptions.
osource "/home/reva/zephyrproject/zephyr/arch/x86/Kconfig"
osource "/home/reva/zephyrproject/zephyr/arch/xtensa/Kconfig"
osource "/home/reva/zephyrproject/zephyr/arch/sparc/Kconfig"
osource "/home/reva/zephyrproject/zephyr/arch/riscv/Kconfig"
osource "/home/reva/zephyrproject/zephyr/arch/posix/Kconfig"
osource "/home/reva/zephyrproject/zephyr/arch/nios2/Kconfig"
osource "/home/reva/zephyrproject/zephyr/arch/mips/Kconfig"
osource "/home/reva/zephyrproject/zephyr/arch/arm64/Kconfig"
osource "/home/reva/zephyrproject/zephyr/arch/arm/Kconfig"
osource "/home/reva/zephyrproject/zephyr/arch/arc/Kconfig"
```

## base_node/build/Kconfig/boards/Kconfig
```kconfig
# Load Zephyr board Kconfig descriptions.
osource "/home/reva/zephyrproject/zephyr/boards/raspberrypi/rpi_pico/Kconfig"
```

## base_node/build/Kconfig/boards/Kconfig.defconfig
```kconfig
# Load Zephyr board defconfig descriptions.
osource "/home/reva/zephyrproject/zephyr/boards/raspberrypi/rpi_pico/Kconfig.defconfig"
```

## base_node/build/Kconfig/boards/Kconfig.rpi_pico
```kconfig
# Load board Kconfig descriptions.
osource "/home/reva/zephyrproject/zephyr/boards/raspberrypi/rpi_pico/Kconfig.rpi_pico"
```

## base_node/build/Kconfig/boards/Kconfig.sysbuild
```kconfig
# Load Sysbuild board Kconfig descriptions.
osource "/home/reva/zephyrproject/zephyr/boards/raspberrypi/rpi_pico/Kconfig.sysbuild"
```

## base_node/drivers/Kconfig
```kconfig
# Copyright (c) 2023
# SPDX-License-Identifier: Apache-2.0

rsource "sensor/Kconfig"
```

## zephyr_base_node/driver/Kconfig
```kconfig
# Kconfig - Sensor Node driver configuration options

config SENSOR_NODE
	bool "Sensor Node driver for Smart Gardening System"
	default y
	depends on SENSOR && SERIAL
	help
	  Enable Sensor Node driver that communicates with a separate
	  Raspberry Pi Pico running the sensor firmware.

if SENSOR_NODE

config SENSOR_NODE_THREAD_STACK_SIZE
	int "Stack size for the sensor node processing thread"
	default 2048
	help
	  Size of the stack used by the sensor node processing thread.

config SENSOR_NODE_THREAD_PRIORITY
	int "Priority for the sensor node processing thread"
	default 5
	help
	  Priority at which the sensor node thread should run.

config SENSOR_NODE_FETCH_INTERVAL_MS
	int "Default interval between sensor data fetches (ms)"
	default 5000
	help
	  Default interval between automatic data fetches.

endif # SENSOR_NODE
```

## zephyr_base_node/driver/dts/bindings/sensor/garden,sensor-node.yaml
```yaml
description: Sensor Node driver for Smart Gardening System

compatible: "garden,sensor-node"

include: base.yaml

properties:
  uart-dev:
    type: phandle
    required: true
    description: UART device to use for communication with the sensor node

  tx-pin:
    type: int
    required: true
    description: GPIO pin number for UART TX

  rx-pin:
    type: int
    required: true
    description: GPIO pin number for UART RX
```
