## base_node/drivers/sensor/sensor_node/Kconfig
```kconfig
# Copyright (c) 2023
# SPDX-License-Identifier: Apache-2.0

menuconfig SENSOR_NODE
	bool "Sensor Node Driver"
	depends on SERIAL
	help
	  Enable sensor node driver that communicates over UART

if SENSOR_NODE

config SENSOR_NODE_INIT_PRIORITY
	int "Init priority"
	default 90
	help
	  Sensor node initialization priority

endif # SENSOR_NODE
```
